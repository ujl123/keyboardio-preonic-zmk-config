## config/west.yml
```yaml
manifest:
  remotes:
    - name: zmkfirmware
      url-base: https://github.com/zmkfirmware
    - name: keyboardio
      url-base: https://github.com/keyboardio
    - name: replicaJunction
      url-base: https://github.com/replicaJunction
    - name: ssbb
      url-base: https://github.com/ssbb
    # Additional modules containing boards/shields/custom code can be listed here as well
    # See https://docs.zephyrproject.org/3.2.0/develop/west/manifest.html#projects
  projects:
    - name: zmk
      remote: zmkfirmware
      revision: main
      import: app/west.yml
    - name: keyboardio-preonic-zmk-module
      remote: keyboardio
      revision: main
#    - name: keyboardio-preonic-zmk-module
#      remote: replicaJunction
#      revision: zmk-studio
    - name: zmk-listeners
      remote: ssbb
      revision: v1
  self:
    path: config
```
